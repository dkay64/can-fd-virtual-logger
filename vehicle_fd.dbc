VERSION "LucidPrep quick virtual CAN FD demo"

NS_ :

BS_:

BU_: SIM_ECU DASH_LOGGER

BO_ 291 VehStatFd: 16 SIM_ECU
 SG_ VehSpeed : 0|16@1+ (0.01,0) [0|250] "km/h" DASH_LOGGER
 SG_ EngRpm : 16|16@1+ (0.25,0) [0|8000] "rpm" DASH_LOGGER
 SG_ BrkPressed : 32|1@1+ (1,0) [0|1] "" DASH_LOGGER
 SG_ Gear : 40|8@1+ (1,0) [0|8] "" DASH_LOGGER

CM_ BO_ 291 "Virtual status msg for my Python CAN FD logger test.";
CM_ SG_ 291 VehSpeed "Vehicle speed from the fake drive cycle.";
CM_ SG_ 291 EngRpm "RPM estimate from speed, just for decode practice.";

BA_DEF_ BO_ "VFrameFormat" ENUM "StandardCAN","ExtendedCAN","StandardCAN_FD","ExtendedCAN_FD";
BA_ "VFrameFormat" BO_ 291 2;
